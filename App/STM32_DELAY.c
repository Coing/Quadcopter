/*=====================================================================================================*/
/*=====================================================================================================*/
#include "stm32f10x.h"
#include "STM32_DELAY.h"
/*=====================================================================================================*/
/*=====================================================================================================*
**函数 : Delay_NOP
**功能 : 
**输入 : 
**输出 : 
**使用 : 
**=====================================================================================================*/
/*=====================================================================================================*/
void Delay_NOP( u32 nCnt )
{				
  for(; nCnt != 0; nCnt--);
}
/*=====================================================================================================*/
/*=====================================================================================================*
**函数 : Delay_NOP
**功能 : 
**输入 : 
**输出 : 
**使用 : 
**=====================================================================================================*/
/*=====================================================================================================*/
void Delay_1us( u32 nCnt_1us )
{	
	u32 nCnt;
	for(; nCnt_1us != 0; nCnt_1us--)
		for(nCnt = 7; nCnt != 0; nCnt--);
}
/*=====================================================================================================*/
/*=====================================================================================================*
**函数 : Delay_1ms
**功能 : 
**输入 : 
**输出 : 
**使用 : 
**=====================================================================================================*/
/*=====================================================================================================*/
void Delay_1ms( u32 nCnt_1ms )
{	
	u32 nCnt;
	for(; nCnt_1ms != 0; nCnt_1ms--)
		for(nCnt = 10285; nCnt != 0; nCnt--);
}
/*=====================================================================================================*/
/*=====================================================================================================*
**函数 : Delay_10ms
**功能 : 
**输入 : 
**输出 : 
**使用 : 
**=====================================================================================================*/
/*=====================================================================================================*/
void Delay_10ms( u32 nCnt_10ms )
{	
	u32 nCnt;
	for(; nCnt_10ms != 0; nCnt_10ms--)
		for(nCnt = 102855; nCnt != 0; nCnt--);
}
/*=====================================================================================================*/
/*=====================================================================================================*
**函数 : Delay_20ms
**功能 : 
**输入 : 
**输出 : 
**使用 : 
**=====================================================================================================*/
/*=====================================================================================================*/
void Delay_20ms( u32 nCnt_20ms )
{	
	u32 nCnt;
	for(; nCnt_20ms != 0; nCnt_20ms--)
		for(nCnt = 205710; nCnt != 0; nCnt--);
}
/*=====================================================================================================*/
/*=====================================================================================================*/
